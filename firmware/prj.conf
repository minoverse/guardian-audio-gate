## CMakeLists.txt
```
cmake_minimum_required(VERSION 3.20.0)
find_package(Zephyr REQUIRED HINTS $ENV{ZEPHYR_BASE})
project(guardian_audio_gate)

# Add Guardian DSP library
add_subdirectory(lib/guardian_dsp)

# Add Guardian Gate library (Week 6 decision logic)
add_subdirectory(lib/guardian_gate)

# Add Guardian SDK — portable C99 pre-filter (no CMSIS/Zephyr in public API)
add_subdirectory(lib/guardian_sdk)

# Add Edge Impulse model (Week 15-16 real TinyML)
add_subdirectory(lib/ei_model)

# Edge Impulse needs C++ standard library headers (functional, algorithm, etc.)
# The Zephyr build system doesn't add them by default — find them from the compiler.
execute_process(
    COMMAND ${CMAKE_CXX_COMPILER} -dumpversion
    OUTPUT_VARIABLE GCC_VERSION
    OUTPUT_STRIP_TRAILING_WHITESPACE
)
get_filename_component(GCC_BIN_DIR ${CMAKE_CXX_COMPILER} DIRECTORY)
get_filename_component(TOOLCHAIN_ROOT ${GCC_BIN_DIR} DIRECTORY)
set(CXX_STD_INCLUDE "${TOOLCHAIN_ROOT}/arm-zephyr-eabi/include/c++/${GCC_VERSION}")
target_include_directories(app PRIVATE
    ${CXX_STD_INCLUDE}
    ${CXX_STD_INCLUDE}/arm-zephyr-eabi
)

# ── Fault injection: compile-time guard ──────────────────────────────────────
# Off by default → test helper functions excluded from production binary.
# Enable for fault tolerance testing:
#   west build ... -- -DFAULT_INJECT=ON
option(FAULT_INJECT "Enable fault injection test helpers" OFF)
if(FAULT_INJECT)
    target_compile_definitions(app      PRIVATE FAULT_INJECT_ENABLED=1)
    target_compile_definitions(guardian_dsp PRIVATE FAULT_INJECT_ENABLED=1)
    message(STATUS "Guardian: FAULT_INJECT enabled — test helpers compiled in")
endif()

# Main application source
target_sources(app PRIVATE
    src/main.c
    src/ei_classifier_wrapper.cpp
)

# Link Guardian libraries
target_link_libraries(app PRIVATE guardian_dsp guardian_gate guardian_sdk)
```

## prj.conf
```kconfig
# ── Hardware watchdog ─────────────────────────────────────────────────────────
# Last-resort recovery: if the entire main thread hangs (software watchdog
# can't fire), WDT resets the SoC after 500ms.
# Two-layer design:
#   Layer 1 — software stall watchdog (75ms): restarts PDM peripheral
#   Layer 2 — hardware WDT (500ms)          : full SoC reset if layer 1 hangs
CONFIG_WATCHDOG=y
CONFIG_WDT_NRFX=y

CONFIG_PRINTK=y
CONFIG_SERIAL=y
CONFIG_CONSOLE=y
CONFIG_UART_CONSOLE=y
CONFIG_FPU=y
CONFIG_CMSIS_DSP=y
CONFIG_CMSIS_DSP_FILTERING=y
CONFIG_CMSIS_DSP_STATISTICS=y
CONFIG_CMSIS_DSP_TRANSFORM=y
CONFIG_CMSIS_DSP_MATRIX=y
CONFIG_CMSIS_DSP_FASTMATH=y
CONFIG_CMSIS_DSP_COMPLEXMATH=y
CONFIG_TIMING_FUNCTIONS=y
CONFIG_NRFX_PDM=y
CONFIG_NRFX_CLOCK=y
CONFIG_NRFX_NVMC=y
CONFIG_ARM_MPU=n
CONFIG_BOOTLOADER_MCUBOOT=n

# Edge Impulse C++ SDK
CONFIG_CPP=y
CONFIG_STD_CPP14=y
CONFIG_FPU_SHARING=y
CONFIG_NEWLIB_LIBC=y

# TFLite micro needs significant stack for MFCC + inference
CONFIG_MAIN_STACK_SIZE=8192

# SystemView — disabled (using printk for timing analysis instead)
CONFIG_TRACING=n
CONFIG_SEGGER_SYSTEMVIEW=n

# ── Week 15-16 Opt #5: BLE beacon for jitter stress test ─────────────────────
# BLE stack enabled by prj_ble_jitter.conf overlay only.
# Build with: west build ... -- -DEXTRA_CONF_FILE=prj_ble_jitter.conf
```

## prj_ble_jitter.conf
```kconfig
# ── BLE Jitter Test overlay ───────────────────────────────────────────────────
# Build with:
#   west build -s ~/projects/guardian-audio-gate/firmware \
#     -b nrf52840dk/nrf52840 -- -DEXTRA_CONF_FILE=prj_ble_jitter.conf
#
# This enables a BLE beacon (non-connectable advertiser, 100ms interval)
# running concurrently with the gate. The nRF52840 radio IRQ fires every
# 100ms and steals ~500µs from the CPU. Measures real-world gate jitter.

# BLE stack
CONFIG_BT=y
CONFIG_BT_PERIPHERAL=y
CONFIG_BT_DEVICE_NAME="GuardianGate"

# Advertiser: non-connectable, 100ms interval (worst-case radio contention)
CONFIG_BT_EXT_ADV=n

# Needs larger stack for BLE stack threads
CONFIG_SYSTEM_WORKQUEUE_STACK_SIZE=2048
CONFIG_BT_RX_STACK_SIZE=1024

# BLE_JITTER_TEST is a plain #define in main.c (not Kconfig) — controlled by
# whether CONFIG_BT is set. No extra line needed here.
```

## prj_power_test.conf
```kconfig
# Power measurement overlay — disable all UART/console activity so the CPU
# can actually sleep between frames and PPK2 reads reflect true idle current.
#
# Build with:
#   west build -b nrf52840dk/nrf52840 -- -DEXTRA_CONF_FILE=prj_power_test.conf
#
# Flash DMA binary  → measure baseline
# Set POLL_MODE_TEST 1, rebuild, flash → compare

# ── Kill UART (the dominant power consumer in the baseline measurement) ───────
CONFIG_SERIAL=n
CONFIG_CONSOLE=n
CONFIG_UART_CONSOLE=n
CONFIG_PRINTK=n
CONFIG_STDOUT_CONSOLE=n

# ── Kill SystemView/RTT (RTT polling also prevents deep sleep) ────────────────
CONFIG_TRACING=n
CONFIG_SEGGER_SYSTEMVIEW=n
CONFIG_USE_SEGGER_RTT=n
```

## prj_week6_backup.conf
```kconfig
CONFIG_PRINTK=y
CONFIG_SERIAL=y
CONFIG_CONSOLE=y
CONFIG_UART_CONSOLE=y
CONFIG_FPU=y
CONFIG_CMSIS_DSP=y
CONFIG_CMSIS_DSP_FILTERING=y
CONFIG_CMSIS_DSP_STATISTICS=y
CONFIG_TIMING_FUNCTIONS=y
CONFIG_NRFX_PDM=y
CONFIG_NRFX_CLOCK=y
CONFIG_ARM_MPU=n
CONFIG_BOOTLOADER_MCUBOOT=n

# SystemView — enable when Week 5.5 is implemented (after Week 6)
# CONFIG_SEGGER_SYSTEMVIEW=y
# CONFIG_THREAD_NAME=y
# CONFIG_THREAD_STACK_INFO=y
# CONFIG_INIT_STACKS=y
# CONFIG_SEGGER_SYSTEMVIEW_RTT_BUFFER_SIZE=4096
```

## src/ei_classifier_wrapper.cpp
```c
/*
 * Guardian Audio Gate — Edge Impulse classifier wrapper
 *
 * Thin C++ shim so main.c (pure C) can call run_classifier().
 * Converts the int16_t pre-roll ring buffer → float32 normalized signal
 * on-the-fly via the EI signal callback — zero extra RAM.
 */

#include "ei_classifier_wrapper.h"
#include "edge-impulse-sdk/classifier/ei_run_classifier.h"
#include "model-parameters/model_metadata.h"
#include <zephyr/kernel.h>

/* C++ exception stubs — Zephyr disables exceptions but libstdc++ headers
 * still reference these symbols via std::function / std::vector.
 * Provide weak no-op implementations that halt on unexpected calls.       */
namespace std {
    void __throw_bad_function_call()              { k_panic(); }
    void __throw_length_error(const char *)       { k_panic(); }
    void __throw_out_of_range_fmt(const char *,
                                  ...)            { k_panic(); }
    void __throw_bad_alloc()                      { k_panic(); }
}

/* Module state filled before each inference */
static const int16_t *g_ring     = nullptr;
static uint32_t       g_head     = 0;
static uint32_t       g_filled   = 0;
static uint32_t       g_n_frames = 0;
static uint32_t       g_frame_sz = 0;

/*
 * Edge Impulse signal callback.
 * Maps a linear [0, EI_CLASSIFIER_RAW_SAMPLE_COUNT) offset to the circular
 * pre-roll ring.  Missing samples at the start are zero-padded (first wake
 * before ring is fully filled).
 */
static int get_signal_data(size_t offset, size_t length, float *out_ptr)
{
    uint32_t available   = g_filled * g_frame_sz;
    uint32_t needed      = EI_CLASSIFIER_RAW_SAMPLE_COUNT; /* 16000 */
    uint32_t pad_samples = (available < needed) ? (needed - available) : 0U;

    for (size_t i = 0; i < length; i++) {
        size_t abs_idx = offset + i;
        if (abs_idx < pad_samples) {
            out_ptr[i] = 0.0f; /* zero-pad silence at start */
        } else {
            size_t ring_idx   = abs_idx - pad_samples;
            size_t frame_idx  = ring_idx / g_frame_sz;
            size_t sample_idx = ring_idx % g_frame_sz;
            /* oldest slot = (head + 0) % n_frames */
            size_t ring_frame = (g_head + frame_idx) % g_n_frames;
            out_ptr[i] = (float)g_ring[ring_frame * g_frame_sz + sample_idx]
                         / 32768.0f;
        }
    }
    return 0;
}

extern "C" int ei_classify(const int16_t *ring_flat,
                           uint32_t head, uint32_t filled,
                           uint32_t n_frames, uint32_t frame_size,
                           ei_kws_result_t *out)
{
    if (!ring_flat || !out) { return -1; }

    g_ring     = ring_flat;
    g_head     = head;
    g_filled   = filled;
    g_n_frames = n_frames;
    g_frame_sz = frame_size;

    signal_t signal;
    signal.total_length = EI_CLASSIFIER_RAW_SAMPLE_COUNT;
    signal.get_data     = get_signal_data;

    ei_impulse_result_t result = {};
    EI_IMPULSE_ERROR err = run_classifier(&signal, &result, false);
    if (err != EI_IMPULSE_OK) { return -(int)err; }

    /* Find highest-confidence label */
    out->label = result.classification[0].label;
    out->score = result.classification[0].value;
    for (int i = 1; i < EI_CLASSIFIER_LABEL_COUNT; i++) {
        if (result.classification[i].value > out->score) {
            out->label = result.classification[i].label;
            out->score = result.classification[i].value;
        }
    }
    return 0;
}
```

## src/ei_classifier_wrapper.h
```c
#ifndef EI_CLASSIFIER_WRAPPER_H
#define EI_CLASSIFIER_WRAPPER_H

#include <stdint.h>

#ifdef __cplusplus
extern "C" {
#endif

/* Best classification result from Edge Impulse keyword spotting model */
typedef struct {
    const char *label;  /* "yes", "no", "unknown", "noise" */
    float       score;  /* 0.0–1.0 confidence */
} ei_kws_result_t;

/* Run keyword spotting on the pre-roll ring buffer.
 *
 * ring_flat  : (const int16_t *)preroll_ring — flat view of 2D ring
 * head       : preroll_head  — next write slot (oldest frame index)
 * filled     : preroll_filled — number of valid frames (0..n_frames)
 * n_frames   : PREROLL_FRAMES
 * frame_size : FRAME_SIZE (320 samples)
 * out        : receives best label + confidence
 *
 * Returns 0 on success, negative on error.
 * Shorter context is zero-padded at the start (first call after boot).
 */
int ei_classify(const int16_t *ring_flat,
                uint32_t head, uint32_t filled,
                uint32_t n_frames, uint32_t frame_size,
                ei_kws_result_t *out);

#ifdef __cplusplus
}
#endif

#endif /* EI_CLASSIFIER_WRAPPER_H */
```

## src/main_week6_backup.c
```c
#include <zephyr/kernel.h>
#include <zephyr/sys/printk.h>
#include <zephyr/timing/timing.h>
#include <arm_math.h>
#include "guardian/audio/dma_pdm.h"
#include "guardian/resonator_df2t.h"
#include "guardian/gate/decision.h"

/* ── Test audio mode ──────────────────────────────────────────────────────────
 * Set one of these to 1 to inject synthetic audio instead of the DMA mic.
 *
 *  TEST_AUDIO_SINE  = 800 Hz sine → expect WAKE  (speech-like, periodic)
 *  TEST_AUDIO_NOISE = LFSR noise  → expect ABORT (broadband, no correlation)
 *
 * Set both to 0 to use the real PDM microphone.
 * ─────────────────────────────────────────────────────────────────────────── */
#define TEST_AUDIO_SINE  0
#define TEST_AUDIO_NOISE 0

#if (TEST_AUDIO_SINE && TEST_AUDIO_NOISE)
#error "Set only one of TEST_AUDIO_SINE or TEST_AUDIO_NOISE, not both"
#endif

/* ── Synthetic audio helpers ─────────────────────────────────────────────── */

#if TEST_AUDIO_SINE
/* 800 Hz sine at 16 kHz sample rate, 50% amplitude.
 * arm_sin_q15(x): x=0..32767 maps to 0..2π
 * phase_inc = 32768 * 800 / 16000 = 1638                                    */
#define SINE_PHASE_INC 1638
static int16_t test_buf[FRAME_SIZE];
static q15_t   sine_phase = 0;

static int16_t *get_test_frame(void)
{
    for (int i = 0; i < FRAME_SIZE; i++) {
        test_buf[i] = arm_sin_q15(sine_phase) / 2; /* /2 = 50% amplitude */
        sine_phase  = (q15_t)((sine_phase + SINE_PHASE_INC) & 0x7FFF);
    }
    return test_buf;
}
#endif /* TEST_AUDIO_SINE */

#if TEST_AUDIO_NOISE
/* 16-bit Galois LFSR — low amplitude to stay in speech energy range          */
static int16_t test_buf[FRAME_SIZE];
static uint16_t lfsr = 0xACE1u;

static int16_t *get_test_frame(void)
{
    for (int i = 0; i < FRAME_SIZE; i++) {
        lfsr = (lfsr >> 1) ^ (uint16_t)(-(lfsr & 1u) & 0xB400u);
        test_buf[i] = (int16_t)lfsr >> 4; /* scale down: ~12-bit signed range */
    }
    return test_buf;
}
#endif /* TEST_AUDIO_NOISE */

/* ── Application ─────────────────────────────────────────────────────────── */

static resonator_bank_df2t_t bank;
static gate_config_t         config = GATE_CONFIG_DEFAULT;
static noise_tracker_t       noise  = {0};

int main(void)
{
#if TEST_AUDIO_SINE
    printk("\n=== Guardian Week 6 - Gate Decision [TEST: 800Hz SINE] ===\n");
    printk("Expected: WAKE most frames (periodic speech-like signal)\n\n");
#elif TEST_AUDIO_NOISE
    printk("\n=== Guardian Week 6 - Gate Decision [TEST: LFSR NOISE] ===\n");
    printk("Expected: ABORT most frames (broadband noise)\n\n");
#else
    printk("\n=== Guardian Week 6 - Gate Decision [LIVE MIC] ===\n\n");
#endif

    timing_init();
    timing_start();

#if !(TEST_AUDIO_SINE || TEST_AUDIO_NOISE)
    int ret = dma_pdm_init();
    if (ret != 0) {
        printk("DMA PDM init failed: %d\n", ret);
        return ret;
    }
#endif

    resonator_bank_df2t_init(&bank);

#if !(TEST_AUDIO_SINE || TEST_AUDIO_NOISE)
    int ret2 = dma_pdm_start();
    if (ret2 != 0) {
        printk("DMA PDM start failed: %d\n", ret2);
        return ret2;
    }
#endif

    int frame_count = 0;
    int wake_count  = 0;

    while (1) {
        int16_t *frame;

#if (TEST_AUDIO_SINE || TEST_AUDIO_NOISE)
        frame = get_test_frame();
        k_sleep(K_MSEC(20)); /* pace to ~50 frames/s (matches real DMA rate) */
#else
        int ret3 = dma_pdm_read(&frame);
        if (ret3 < 0) {
            continue;
        }

        /* TEMP DIAG: print raw DMA samples and resonator output every 50 frames */
        if (frame_count == 0) {
            int16_t raw_min = frame[0], raw_max = frame[0];
            for (int i = 1; i < FRAME_SIZE; i++) {
                if (frame[i] < raw_min) raw_min = frame[i];
                if (frame[i] > raw_max) raw_max = frame[i];
            }
            printk("RAW: min=%6d max=%6d samples[0..3]=%d %d %d %d\n",
                   raw_min, raw_max, frame[0], frame[1], frame[2], frame[3]);
        }
#endif

        resonator_bank_df2t_process(&bank, frame, FRAME_SIZE);

#if !(TEST_AUDIO_SINE || TEST_AUDIO_NOISE)
        /* TEMP DIAG: print resonator ch0 output range */
        if (frame_count == 0) {
            const int16_t *r0 = resonator_bank_df2t_get_output(&bank, 0);
            int16_t r_min = r0[0], r_max = r0[0];
            for (int i = 1; i < FRAME_SIZE; i++) {
                if (r0[i] < r_min) r_min = r0[i];
                if (r0[i] > r_max) r_max = r0[i];
            }
            printk("RES0: min=%6d max=%6d\n", r_min, r_max);
        }
#endif

        gate_decision_t decision = gate_decide(&bank, &config);

        energy_features_t efeat = { .total_energy = decision.features_used.energy };
        update_noise_floor(&noise, &efeat, decision.should_wake);
        config.noise_floor = noise.noise_estimate;

        if (decision.should_wake) {
            wake_count++;
        }

        if (++frame_count >= 50) {
            frame_count = 0;
            printk("GATE: %s conf=%3u E=%5d C=%6d ZCR=%3u T=%4uus "
                   "noise=%5d wakes=%2d/50\n",
                   decision.should_wake ? "WAKE " : "ABORT",
                   decision.confidence,
                   decision.features_used.energy,
                   decision.features_used.correlation,
                   decision.features_used.zcr,
                   decision.elapsed_us,
                   config.noise_floor,
                   wake_count);
            wake_count = 0;
        }
    }

    return 0;
}
```
